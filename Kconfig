## Kconfig
```kconfig
menu "RoboHub Common"

config ROBOHUB_COMMON
    bool "Enable RoboHub Common Core"
    default y
    help
        Core interfaces, HAL abstractions, registry, platform contract.
        This module is always enabled and required by all platforms.

endmenu
```

## kconfig/hal/Kconfig.adc
```kconfig
menu "HAL ADC"

config RH_HAL_ADC
    bool "Enable HAL ADC interface"
    default n

endmenu
```

## kconfig/hal/Kconfig.dht
```kconfig
menu "HAL DHT"

config RH_HAL_DHT
    bool "Enable HAL DHT single-wire interface"
    default n

endmenu
```

## kconfig/hal/Kconfig.gpio
```kconfig
menu "HAL GPIO"

config RH_HAL_GPIO
    bool "Enable HAL GPIO interface"
    default y

endmenu
```

## kconfig/hal/Kconfig.i2c
```kconfig
menu "HAL I2C"

config RH_HAL_I2C
    bool "Enable HAL I2C interface"
    default n

endmenu
```

## kconfig/hal/Kconfig.net
```kconfig
menu "HAL Network"

config RH_NET
    bool "Enable network interface and sockets"
    default n
    help
      The network contract: an interface brought up by a platform, and sockets
      opened over it. Middleware that speaks MQTT, HTTP or a websocket selects
      it; a platform implements it over esp_netif, cyw43_arch and LwIP, or POSIX.

endmenu
```

## kconfig/hal/Kconfig.onewire
```kconfig
menu "HAL OneWire"

config RH_HAL_ONEWIRE
    bool "Enable HAL OneWire interface"
    default n

endmenu
```

## kconfig/hal/Kconfig.pwm
```kconfig
menu "HAL PWM"

config RH_HAL_PWM
    bool "Enable HAL PWM interface"
    default n

endmenu
```

## kconfig/hal/Kconfig.rs485
```kconfig
menu "HAL RS485"

config RH_HAL_RS485
    bool "Enable HAL RS485 interface"
    default n

endmenu
```

## kconfig/hal/Kconfig.spi
```kconfig
menu "HAL SPI"

config RH_HAL_SPI
    bool "Enable HAL SPI interface"
    default n

endmenu
```

## kconfig/hal/Kconfig.timer
```kconfig
menu "HAL Timer"

config RH_HAL_TIMER
    bool "Enable HAL Timer interface"
    default n

endmenu
```

## kconfig/hal/Kconfig.uart
```kconfig
menu "HAL UART"

config RH_HAL_UART
    bool "Enable HAL UART interface"
    default y

endmenu
```
